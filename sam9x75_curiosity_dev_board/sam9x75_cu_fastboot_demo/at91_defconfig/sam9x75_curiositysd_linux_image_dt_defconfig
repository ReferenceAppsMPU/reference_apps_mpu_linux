## sam9x75_curiosity_dev_board/sam9x75_cu_fastboot_demo/at91_defconfig/sam9x75_curiositysd_linux_image_dt_defconfig
```kconfig
CONFIG_SAM9X7=y
# CONFIG_SCLK is not set
# CONFIG_HW_DISPLAY_BANNER is not set
CONFIG_DDR_SET_BY_DEVICE=y
CONFIG_DDR_W632GU6NB12I=y
CONFIG_SDCARD=y
CONFIG_LOAD_LINUX=y
CONFIG_OVERRIDE_CMDLINE=y
CONFIG_ARG_DELAY=""
CONFIG_ARG_MEMTEST=""
CONFIG_ARG_MTD=""
CONFIG_ARG_PRINTK=""
CONFIG_ARG_ROOTFSTYPE=" rootfstype=ext4"
CONFIG_OF_OVERRIDE_DTB_NAME="at91-sam9x75_curiosity.dtb"
CONFIG_IMAGE_NAME="zImage"
CONFIG_THUMB=y
CONFIG_BOARD_QUIRK_SAM9X75_CURIOSITY=y
CONFIG_LED_ON_BOARD=y
CONFIG_LED_R_ON_PIOC=y
CONFIG_LED_R_PIN=19
CONFIG_LED_G_ON_PIOC=y
CONFIG_LED_G_PIN=21
CONFIG_LED_B_ON_PIOC=y
CONFIG_LED_B_PIN=20
```
